/*
 * Copyright (c) 2015-2019, The Linux Foundation. All rights reserved.
 *
 * This program is free software; you can redistribute it and/or modify
 * it under the terms of the GNU General Public License version 2 and
 * only version 2 as published by the Free Software Foundation.
 *
 * This program is distributed in the hope that it will be useful,
 * but WITHOUT ANY WARRANTY; without even the implied warranty of
 * MERCHANTABILITY or FITNESS FOR A PARTICULAR PURPOSE.  See the
 * GNU General Public License for more details.
 */

/* AWINIC AW8695 Haptic */
&pm8150b_haptics{
    status = "disabled";
};

&qupv3_se7_i2c {
	aw8695_haptic@5A {
		compatible = "awinic,aw8695_haptic";
		reg = <0x5A>;
		reset-gpio = <&tlmm 94 0>;
		irq-gpio = <&tlmm 95 0>;
		status = "okay";
	};
};
