## drivers/fingerprint/Kconfig
```kconfig
#
# NUBIA Fingerprint configuration
#

menuconfig NUBIA_FINGERPRINT
	tristate "Nubia Fingerprint support"
	default n
	help
	  This menu enables a Nubia Fingerprint driver.

if NUBIA_FINGERPRINT

source drivers/fingerprint/gf5288/Kconfig

endif
```

## drivers/fingerprint/gf5288/Kconfig
```kconfig
config NUBIA_SENSORS_FP_GF5288_LEFT
	tristate "nubia sensors fp gf5288(left)"
	default n
	help
	  This is the main file for fingerprint driver for gf5288.
	  Say Y here if you have a gf5216m fingerprint connected
	  to your system.

config NUBIA_SENSORS_FP_GF5288_RIGHT
	tristate "nubia sensors fp gf5288(right)"
	default n
	help
	  This is the main file for fingerprint driver for gf5288.
	  Say Y here if you have a gf5216m fingerprint connected
	  to your system.
```

## drivers/input/touchscreen/goodix_gtx8_front/Kconfig
```kconfig
#
# Goodix touchscreen driver configuration
#

config TOUCHSCREEN_NUBIA_FRONT_GOODIX_GTX8_UPDATE
	tristate "Goodix GTx8 firmware update module"
	default n
	help
	  Say Y here to enable support for doing firmware update.

	  If unsure, say N.

	  To compile this driver as a module, choose M here.

config TOUCHSCREEN_NUBIA_FRONT_GOODIX_GTX8_GESTURE
	tristate "Goodix GTx8 gesture wakeup feature"
	default n
	help
	  Say Y here to enable support for gesture wakeup feature..

	  If unsure, say N.

	  To compile this driver as a module, choose M here.

config TOUCHSCREEN_NUBIA_FRONT_GOODIX_GTX8_TOOLS
	tristate "Goodix touch tools support"
	default n
	help
	  Say Y here to enable debug tools.

	  If unsure, say N.

	  To compile this driver as a module, choose M here.
```

## drivers/leds/nubia/Kconfig
```kconfig
menuconfig NUBIA_LED
	bool "nubia led driver"
	depends on LEDS_CLASS
	help
	  This option enables support for the nubia leds class.

	  If unsure, say Y.

if NUBIA_LED

config NUBIA_LED_AW22XX
	bool "nubia led aw22xxx driver"
	default n
	help
	  Say Y here if you have a nubia led aw22xxx connected to your system.

	  If unsure, say N.

config NUBIA_LED_AW8695
	bool "Haptic driver for awinic AW8695 series"
	depends on I2C
	default n
	help
	  This option enables support for AW8695 series Haptic Driver.

	  If unsure, say N.

config NUBIA_LED0_AW9106
	bool "nubia led0 aw9106 driver"
	default n
	help
	  Say Y here if you have a nubia led aw9106 connected to your system.

	  If unsure, say N.

config NUBIA_LED1_AW9106
	bool "nubia led1 aw9106 driver"
	default n
	help
	  Say Y here if you have a nubia led aw9106 connected to your system.

	  If unsure, say N.

endif # NUBIA_LED
```

## drivers/sensors/Kconfig
```kconfig
config SENSORS_SSC
	bool "Enable Sensors Driver Support for SSC"
	help
	  Add support for sensors SSC driver.
	  This driver is used for exercising sensors use case,
	  time syncing with ADSP clock.

config NUBIA_SENSORS
	bool "Enable HW Sensors Driver Support for nubia"

if NUBIA_SENSORS
source drivers/sensors/nubia/Kconfig
endif
```

## drivers/sensors/nubia/Kconfig
```kconfig
config NUBIA_SENSORS_FRONT_RGB_BH1745
	tristate "nubia front rgb bh1745 sensor device"
	default n
	help
	  If you have a nubia front rgb bh1745 sensor device connected
	  your system, say Y here.

	  If unsure, say N here.

config NUBIA_SENSORS_BACK_TMD2725
	tristate "nubia back light/prox tmd2725 sensor device"
	default n
	help
	  If you have a nubia back light/prox tmd2725 sensor device connected
	  your system, say Y here.

	  If unsure, say N here.

config NUBIA_SENSORS_FRONT_PS_STK3332
	tristate "nubia front proximity stk3332 sensor device"
	default n
	help
	  If you have a nubia front proximity stk3332 sensor device connected
	  your system, say Y here.

	  If unsure, say N here.
```
